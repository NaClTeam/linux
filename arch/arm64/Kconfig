## arch/arm64/um/Kconfig
```kconfig
# SPDX-License-Identifier: GPL-2.0

menu "Host processor features"

source "arch/arm64/Kconfig.cpu"

endmenu

config 64BIT
	def_bool y

config 3_LEVEL_PGTABLES
	def_bool y

config GENERIC_HWEIGHT
	def_bool y
```

## arch/um/configs/arm64_defconfig
```kconfig
CONFIG_NO_HZ=y
# CONFIG_PID_NS is not set
CONFIG_CC_OPTIMIZE_FOR_SIZE=y
CONFIG_CON_CHAN="pts"
CONFIG_SSL_CHAN="pts"
# CONFIG_COMPACTION is not set
# CONFIG_HW_RANDOM is not set
CONFIG_DEBUG_KERNEL=y
CONFIG_DEBUG_INFO_DWARF_TOOLCHAIN_DEFAULT=y
```
